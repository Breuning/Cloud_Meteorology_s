/*
 * RS485DataTask.c
 *
 *  Created on: 2020年7月14日
 *      Author: Breuning
 */

#include "main.h"
#include "string.h"
#include "usart.h"
#include "RS485Task.h"


uint8_t Command_Temhum       [8] = {0x0B, 0x03, 0x01, 0xF4, 0x00, 0x02, 0x84, 0xAF};   //地址11，寄存器地址0x01F4
uint8_t Command_Lllumination [8] = {0x0B, 0x03, 0x01, 0xFA, 0x00, 0x02, 0xE5, 0x6C};   //地址11，寄存器地址0x01FA
uint8_t Command_Winddirection[8] = {0x02, 0x03, 0x00, 0x00, 0x00, 0x02, 0xC4, 0x38};   //地址02，寄存器地址0x0000
uint8_t Command_Windspeed    [8] = {0x01, 0x03, 0x00, 0x00, 0x00, 0x01, 0x84, 0x0A};   //地址01，寄存器地址0x0000

uint8_t Command_Rainfall     [8] = {0x03, 0x03, 0x00, 0x00, 0x00, 0x01, 0x85, 0xE8};   //地址03，寄存器地址0x0000

RS485Data_Struct RS485Data;
BOOL RS485DataReadTimerFlag = FALSE;

static void GetRS485Data(uint8_t *command, RS485Data_Struct *rs485data);


void RS485_Task()
{

	if(RS485DataReadTimerFlag == TRUE)              //通过TIM5设置为每3min读取一次485数据
	{
		RS485DataReadTimerFlag = FALSE;

		GetRS485Data(Command_Temhum, &RS485Data);
		GetRS485Data(Command_Lllumination, &RS485Data);
		GetRS485Data(Command_Winddirection, &RS485Data);
		GetRS485Data(Command_Windspeed, &RS485Data);
		GetRS485Data(Command_Rainfall, &RS485Data);
	}

}

static void GetRS485Data(uint8_t *command, RS485Data_Struct *rs485data)
{
	uint16_t RS485Data_CrcVal;
    uint16_t RS485Data_CheckCrc;

    RS485Uart_RX_TX_Switch(TRANSMIT);
    HAL_Delay(5);
	HAL_UART_Transmit(&huart4, command, 8, 0xff);
	RS485Uart_RX_TX_Switch(RECEIVE);
	HAL_Delay(100);

	if(RS485Uart_RX.receive_flag == 1)
	{
		if(command == Command_Windspeed || command == Command_Rainfall)
		{
			if(RS485Uart_RX.rx_len != 7)
				return;

			RS485Data_CrcVal   = (RS485Uart_RX.RX_Buf[5]<<8) | RS485Uart_RX.RX_Buf[6];
			RS485Data_CheckCrc = CRC16(RS485Uart_RX.RX_Buf, 5);
		}
		else
		{
			if(RS485Uart_RX.rx_len != 9)
				return;

			RS485Data_CrcVal   = (RS485Uart_RX.RX_Buf[7]<<8) | RS485Uart_RX.RX_Buf[8];
			RS485Data_CheckCrc = CRC16(RS485Uart_RX.RX_Buf, 7);
		}

		if(RS485Data_CrcVal != RS485Data_CheckCrc)
			return;




		if(command == Command_Temhum)
		{
			rs485data->Temperature = (float)(((RS485Uart_RX.RX_Buf[5] << 8) | RS485Uart_RX.RX_Buf[6]) / 10.0);
			rs485data->Humidity    = (float)(((RS485Uart_RX.RX_Buf[3] << 8) | RS485Uart_RX.RX_Buf[4]) / 10.0);
		}
		else if(command == Command_Lllumination)
		{
			UINT32 illu;
			illu.stByte.Byte[0] = RS485Uart_RX.RX_Buf[6];
			illu.stByte.Byte[1] = RS485Uart_RX.RX_Buf[5];
			illu.stByte.Byte[2] = RS485Uart_RX.RX_Buf[4];
			illu.stByte.Byte[3] = RS485Uart_RX.RX_Buf[3];
			rs485data->Illumination = illu.all;
		}
		else if(command == Command_Winddirection)
		{
			rs485data->Winddirection = (float)(((RS485Uart_RX.RX_Buf[5] << 8) | RS485Uart_RX.RX_Buf[6]));
		}
		else if(command == Command_Windspeed)
		{
			rs485data->Windspeed     = (float)(((RS485Uart_RX.RX_Buf[3] << 8) | RS485Uart_RX.RX_Buf[4]) / 10.0);
		}
		else if(command == Command_Rainfall)
		{
			rs485data->Rainfall      = (float)(((RS485Uart_RX.RX_Buf[3] << 8) | RS485Uart_RX.RX_Buf[4]) / 10.0);
		}
		else
			return;


		RS485Uart_RX.receive_flag = 0;
		memset(RS485Uart_RX.RX_Buf, 0 , sizeof(RS485Uart_RX.RX_Buf));

//		HAL_UART_Receive_DMA(&huart4, RS485Uart_RX.RX_Buf, RECEIVELEN);
	}
}


void RS485Uart_RX_TX_Switch(RS485_STATE RS485state)
{
	if(RS485state == TRANSMIT)
		HAL_GPIO_WritePin(RS485_SEL_GPIO_Port, RS485_SEL_Pin, GPIO_PIN_SET);		//拉高RS485_SEL脚，RS485为发送状态
	if(RS485state == RECEIVE)
		HAL_GPIO_WritePin(RS485_SEL_GPIO_Port, RS485_SEL_Pin, GPIO_PIN_RESET);		//拉低RS485_SEL脚，RS485为接收状态
}

const uint8_t auchCRCHi[] =
 {
    0x00,0xC1,0x81,0x40,0x01,0xC0,0x80,0x41,
    0x01,0xC0,0x80,0x41,0x00,0xC1,0x81,0x40,
    0x01,0xC0,0x80,0x41,0x00,0xC1,0x81,0x40,
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    0x01,0xC0,0x80,0x41,0x00,0xC1,0x81,0x40
};

const uint8_t auchCRCLo[] =
{
    0x00,0xC0,0xC1,0x01,0xC3,0x03,0x02,0xC2,
    0xC6,0x06,0x07,0xC7,0x05,0xC5,0xC4,0x04,
    0xCC,0x0C,0x0D,0xCD,0x0F,0xCF,0xCE,0x0E,
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    0x82,0x42,0x43,0x83,0x41,0x81,0x80,0x40
};

uint16_t CRC16(uint8_t *puchMsg, uint8_t usDataLen)
{

	uint8_t uchCRCHi = 0xFF;
	uint8_t uchCRCLo = 0xFF;
	uint8_t uIndex;

	while (usDataLen--)
	{
		uIndex = uchCRCHi ^ *puchMsg++;
		uchCRCHi = uchCRCLo ^ auchCRCHi[uIndex];
		uchCRCLo = auchCRCLo[uIndex];
	}
	return (uchCRCHi << 8 | uchCRCLo);
}
